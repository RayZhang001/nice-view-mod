## boards/shields/nice_view_custom/Kconfig.defconfig
```kconfig
# Copyright (c) 2023 The ZMK Contributors
# SPDX-License-Identifier: MIT

if SHIELD_NICE_VIEW_CUSTOM

config LV_Z_VDB_SIZE
    default 100

config LV_DPI_DEF
    default 161

config LV_Z_BITS_PER_PIXEL
    default 1

choice LV_COLOR_DEPTH
    default LV_COLOR_DEPTH_1
endchoice

choice ZMK_DISPLAY_WORK_QUEUE
    default ZMK_DISPLAY_WORK_QUEUE_DEDICATED
endchoice

choice ZMK_DISPLAY_STATUS_SCREEN
    default ZMK_DISPLAY_STATUS_SCREEN_CUSTOM
endchoice

config LV_Z_MEM_POOL_SIZE
    default 4096 if ZMK_DISPLAY_STATUS_SCREEN_CUSTOM

config ZMK_DISPLAY_STATUS_SCREEN_CUSTOM
    imply NICE_VIEW_WIDGET_STATUS

config NICE_VIEW_WIDGET_STATUS
    bool "Custom nice!view status widget"
    select LV_FONT_MONTSERRAT_16
    select LV_USE_IMG
    select LV_USE_CANVAS

config NICE_VIEW_WIDGET_INVERTED
    bool "Invert custom status widget colors"

config ZMK_WPM_GRAPH_ENABLED
    bool "Enable WPM graph"
    default y

if !ZMK_SPLIT || ZMK_SPLIT_ROLE_CENTRAL

config NICE_VIEW_WIDGET_STATUS
    select LV_FONT_MONTSERRAT_18
    select LV_FONT_MONTSERRAT_14
    select LV_FONT_UNSCII_8
    select ZMK_WPM

config ZMK_WIDGET_MODIFIERS
    bool "Show modifier status widget"
    depends on ZMK_DISPLAY
    select LV_USE_LINE
    select ZMK_KEYCODE_STATE_CHANGED
    select ZMK_HID
    default y

config ZMK_DONGLE_DISPLAY_MAC_MODIFIERS
    bool "Show Mac-style modifier icons"
    depends on ZMK_WIDGET_MODIFIERS
    default y

endif # !ZMK_SPLIT || ZMK_SPLIT_ROLE_CENTRAL

config ZMK_DISPLAY_STATUS_SCREEN_BUILT_IN
    select LV_FONT_MONTSERRAT_26

config ZMK_DISPLAY
    default y

config NICE_VIEW_WIDGET_STATUS
    default y

config ZMK_WIDGET_MODIFIERS_DEBUG
    bool "Enable debug logging for modifiers widget"
    default n
    depends on ZMK_WIDGET_MODIFIERS     

endif # SHIELD_NICE_VIEW_CUSTOM
```
